## boards/shields/sweep/Kconfig.defconfig
```kconfig
if SHIELD_SWEEP_LEFT
# Name must be less than 16 characters long!
config ZMK_KEYBOARD_NAME
    default "Sweep"

config ZMK_SPLIT_ROLE_CENTRAL
    default y

endif


if SHIELD_SWEEP_LEFT || SHIELD_SWEEP_RIGHT
config ZMK_SPLIT
    default y
endif


config ZMK_POINTING
    default y

# Assuming pointing device uses SPI
config SPI
    default y

# config SPI
#     default y

# config SSD16XX
#     default y

# config LV_Z_VDB_SIZE
# default 100

# config LV_DPI_DEF
#     default 130

# config LV_Z_BITS_PER_PIXEL
#     default 1

# choice LV_COLOR_DEPTH
#     default LV_COLOR_DEPTH_16
# endchoice

# config ZMK_DISPLAY_BLANK_ON_IDLE
# default n

# config HEAP_MEM_POOL_SIZE
#     default 1024

# config LV_Z_MEM_POOL_SIZE
#     default 4096

# config LV_USE_THEME_MONO
#     default y

# choice ZMK_DISPLAY_WORK_QUEUE
#     default ZMK_DISPLAY_WORK_QUEUE_DEDICATED
# endchoice


config SPI
    default y

config SSD16XX
    default y


if LVGL

config LV_Z_VDB_SIZE
    default 64

config LV_DPI_DEF
    default 148

config LV_Z_BITS_PER_PIXEL
    default 1

choice LV_COLOR_DEPTH
    default LV_COLOR_DEPTH_16
endchoice


endif # LVGL
```

## boards/shields/sweep/Kconfig.shield
```kconfig
# No whitespace after the comma or in your part name!
config SHIELD_SWEEP_LEFT
    def_bool $(shields_list_contains,sweep_left)

# No whitespace after the comma or in your part name!
config SHIELD_SWEEP_RIGHT
    def_bool $(shields_list_contains,sweep_right)
```

## config/west.yml
```yaml
manifest:
  remotes:
    - name: zmkfirmware
      url-base: https://github.com/zmkfirmware
    # Add this:
    - name: halfdane
      url-base: https://github.com/halfdane/
  projects:
    - name: zmk
      remote: zmkfirmware
      revision: main
      import: app/west.yml
    # Add this:
    # - name: zmk-input-gestures
    #   remote: halfdane
    #   revision: main
    # Add these if you want to use absolute mode:
    - name: zmk-input-processors
      remote: halfdane
      revision: main
    - name: cirque-input-module
      remote: halfdane
      revision: absolute_mode
```
